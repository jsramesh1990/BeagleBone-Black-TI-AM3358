## BeagleBone_Black–TI_AM3358/yocto/meta-box-storage/conf/layer.conf
```bitbake
BBPATH .= ":${LAYERDIR}"

BBFILES += "${LAYERDIR}/recipes-*/*/*.bb"
BBFILES += "${LAYERDIR}/recipes-*/*/*.bbappend"

BBFILE_COLLECTIONS += "box-storage"
BBFILE_PATTERN_box-storage = "^${LAYERDIR}/"
BBFILE_PRIORITY_box-storage = "7"

LAYERDEPENDS_box-storage = "core"
LAYERSERIES_COMPAT_box-storage = "scarthgap"
```
